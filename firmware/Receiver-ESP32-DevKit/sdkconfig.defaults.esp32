## firmware/Receiver-ESP32-DevKit/sdkconfig.defaults.esp32
```kconfig
# TankSync Receiver - ESP32 DevKit v1 (CP2102) target overrides.
# Auto-merged with sdkconfig.defaults when `idf.py set-target esp32` runs.
#
# CPU is a dual-core Xtensa LX6 at 240 MHz. UART0 over CP2102 is the console.
# No PSRAM. Stock 4 MB flash via partitions.csv.

# Console — UART0 via CP2102.
CONFIG_ESP_CONSOLE_UART_DEFAULT=y
```

## firmware/Receiver-ESP32-DevKit/sdkconfig.defaults.esp32s3
```kconfig
# TankSync Receiver - ESP32-S3 SuperMini (FH4R2) target overrides.
# Auto-merged with sdkconfig.defaults when `idf.py set-target esp32s3` runs.
#
# CPU is a dual-core Xtensa LX7 at 240 MHz. Embedded 4 MB flash + 2 MB QSPI
# PSRAM in the same package. Console runs over the native USB-Serial/JTAG
# (no external USB-UART chip — the S3 has USB peripherals on GPIO19/20).

# Console — native USB-Serial/JTAG (replaces UART0 console on this board).
CONFIG_ESP_CONSOLE_USB_SERIAL_JTAG=y

# PSRAM — 2 MB embedded quad PSRAM, drives via standard quad SPI.
CONFIG_SPIRAM=y
CONFIG_SPIRAM_MODE_QUAD=y
CONFIG_SPIRAM_SPEED_80M=y
CONFIG_SPIRAM_USE_MALLOC=y
CONFIG_SPIRAM_MALLOC_ALWAYSINTERNAL=16384
CONFIG_SPIRAM_TRY_ALLOCATE_WIFI_LWIP=y

# Flash mode — S3 SuperMini stock is QIO @ 80 MHz, faster than DevKit's DIO.
# Falls back gracefully if the board variant is DIO-wired.
CONFIG_ESPTOOLPY_FLASHMODE_QIO=y

# Idle-task WDT check on CPU1 (S3 second core). The common defaults already
# cover CPU0; this extends watchdog coverage to the app CPU as well.
CONFIG_ESP_TASK_WDT_CHECK_IDLE_TASK_CPU1=y

# Wi-Fi RX block-ack window. S3's ESP-IDF default is 16, but the shared
# defaults pin WIFI_STATIC_RX_BUFFER_NUM=4 and DYNAMIC=8 — both smaller than
# 16, which trips a compile-time #error in esp_wifi/wifi_init.c. We use the
# same effective behaviour as ESP32 (BA_WIN=6) so the buffer/window math
# stays consistent across targets. Raise all three together if a future
# release demands more Wi-Fi throughput.
CONFIG_ESP_WIFI_RX_BA_WIN=6
```

## firmware/Transmitter-IDF/sdkconfig.defaults
```kconfig
# TankSync Transmitter — sdkconfig defaults (production)
#
# NOTE: ESP-IDF ignores CONFIG_ESP_WIFI_ENABLED=n in defaults.
# After `set-target esp32c3`, run:
#   sed -i '' 's/CONFIG_ESP_WIFI_ENABLED=y/# CONFIG_ESP_WIFI_ENABLED is not set/' sdkconfig

# Custom partition table with dual OTA slots (required for LoRa OTA)
CONFIG_PARTITION_TABLE_CUSTOM=y
CONFIG_PARTITION_TABLE_CUSTOM_FILENAME="partitions.csv"

# 4MB flash (ESP32-C3 SuperMini)
CONFIG_ESPTOOLPY_FLASHSIZE_4MB=y

# INT WDT: 800ms (not disabled) — tolerates systimer HAL glitch on C3 rev 0.4
# after deep sleep, while still catching real ISR hangs
CONFIG_ESP_INT_WDT=y
CONFIG_ESP_INT_WDT_TIMEOUT_MS=800

# Main task stack: 6KB (OTA path uses ~1.4KB in buffers alone)
CONFIG_ESP_MAIN_TASK_STACK_SIZE=6144

# OTA rollback: boot falls back to previous firmware if new one crashes
CONFIG_BOOTLOADER_APP_ROLLBACK_ENABLE=y

# Debug optimization (-Og) — SIZE (-Os) triggers INT WDT on ESP32-C3
CONFIG_COMPILER_OPTIMIZATION_DEBUG=y

# Nano printf — saves ~10KB but breaks float format; we use integer millivolts
CONFIG_NEWLIB_NANO_FORMAT=y

# Log level: INFO for development, WARN for production releases
CONFIG_LOG_DEFAULT_LEVEL_INFO=y
CONFIG_LOG_DEFAULT_LEVEL=3
```

## firmware/receiver-c3/sdkconfig.defaults
```kconfig
# TankSync Receiver - ESP32-C3 SDK defaults
# Target
CONFIG_IDF_TARGET="esp32c3"
CONFIG_ESPTOOLPY_FLASHSIZE_4MB=y
CONFIG_ESPTOOLPY_FLASHMODE_DIO=y
CONFIG_ESPTOOLPY_FLASHFREQ_80M=y

# Partition table
CONFIG_PARTITION_TABLE_CUSTOM=y
CONFIG_PARTITION_TABLE_CUSTOM_FILENAME="partitions.csv"

# CPU
CONFIG_ESP_DEFAULT_CPU_FREQ_MHZ_160=y

# FreeRTOS
CONFIG_FREERTOS_HZ=1000
CONFIG_FREERTOS_TIMER_TASK_STACK_DEPTH=3072

# Watchdog - longer timeout for OTA operations
CONFIG_ESP_TASK_WDT_EN=y
CONFIG_ESP_TASK_WDT_TIMEOUT_S=30
CONFIG_ESP_TASK_WDT_CHECK_IDLE_TASK_CPU0=n

# WiFi
CONFIG_ESP_WIFI_STATIC_RX_BUFFER_NUM=4
CONFIG_ESP_WIFI_DYNAMIC_RX_BUFFER_NUM=8
CONFIG_ESP_WIFI_DYNAMIC_TX_BUFFER_NUM=8

# mDNS
CONFIG_MDNS_MAX_SERVICES=5

# MQTT (esp-mqtt built-in)
CONFIG_MQTT_PROTOCOL_311=y
CONFIG_MQTT_TRANSPORT_SSL=y
CONFIG_MQTT_BUFFER_SIZE=512

# OTA / HTTPS
CONFIG_MBEDTLS_CERTIFICATE_BUNDLE=y
CONFIG_MBEDTLS_CERTIFICATE_BUNDLE_DEFAULT_FULL=y
CONFIG_ESP_HTTPS_OTA_ALLOW_HTTP=n
CONFIG_OTA_ALLOW_HTTP=n

# SPIFFS
CONFIG_SPIFFS_USE_MAGIC=y
CONFIG_SPIFFS_USE_MAGIC_LENGTH=y
CONFIG_SPIFFS_META_LENGTH=4
CONFIG_SPIFFS_MAX_PARTITIONS=3

# Log level (info for production)
CONFIG_LOG_DEFAULT_LEVEL_INFO=y

# Core dump to flash (helps debug field failures)
CONFIG_ESP_COREDUMP_ENABLE_TO_FLASH=y
CONFIG_ESP_COREDUMP_DATA_FORMAT_ELF=y

# SNTP
CONFIG_LWIP_SNTP_UPDATE_DELAY=3600000

# Heap tracing off in production
CONFIG_HEAP_TRACING_STANDALONE=n

# UART buffer sizes
CONFIG_UART_ISR_IN_IRAM=y
```

## firmware/receiver/sdkconfig.defaults
```kconfig
# TankSync Receiver - ESP32 DevKit v1 (CP2102) SDK defaults
# Target: ESP32 (dual-core Xtensa LX6)
CONFIG_IDF_TARGET="esp32"
CONFIG_ESPTOOLPY_FLASHSIZE_4MB=y
CONFIG_ESPTOOLPY_FLASHMODE_DIO=y
CONFIG_ESPTOOLPY_FLASHFREQ_80M=y

# Partition table
CONFIG_PARTITION_TABLE_CUSTOM=y
CONFIG_PARTITION_TABLE_CUSTOM_FILENAME="partitions.csv"

# CPU — dual core, 240MHz
CONFIG_ESP_DEFAULT_CPU_FREQ_MHZ_240=y

# FreeRTOS
CONFIG_FREERTOS_HZ=1000
CONFIG_FREERTOS_TIMER_TASK_STACK_DEPTH=3072

# Watchdog — INT WDT works properly on ESP32 (no systimer bug)
CONFIG_ESP_INT_WDT=y
CONFIG_ESP_INT_WDT_TIMEOUT_MS=300
CONFIG_ESP_TASK_WDT_EN=y
CONFIG_ESP_TASK_WDT_TIMEOUT_S=30
CONFIG_ESP_TASK_WDT_CHECK_IDLE_TASK_CPU0=y

# WiFi
CONFIG_ESP_WIFI_STATIC_RX_BUFFER_NUM=4
CONFIG_ESP_WIFI_DYNAMIC_RX_BUFFER_NUM=8
CONFIG_ESP_WIFI_DYNAMIC_TX_BUFFER_NUM=8

# mDNS
CONFIG_MDNS_MAX_SERVICES=5

# MQTT
CONFIG_MQTT_PROTOCOL_311=y
CONFIG_MQTT_TRANSPORT_SSL=y
CONFIG_MQTT_BUFFER_SIZE=512

# OTA / HTTPS
CONFIG_MBEDTLS_CERTIFICATE_BUNDLE=y
CONFIG_MBEDTLS_CERTIFICATE_BUNDLE_DEFAULT_FULL=y

# SPIFFS
CONFIG_SPIFFS_USE_MAGIC=y
CONFIG_SPIFFS_USE_MAGIC_LENGTH=y
CONFIG_SPIFFS_META_LENGTH=4
CONFIG_SPIFFS_MAX_PARTITIONS=3

# Log level
CONFIG_LOG_DEFAULT_LEVEL_INFO=y

# Core dump to flash
CONFIG_ESP_COREDUMP_ENABLE_TO_FLASH=y
CONFIG_ESP_COREDUMP_DATA_FORMAT_ELF=y

# UART
CONFIG_UART_ISR_IN_IRAM=y
```
